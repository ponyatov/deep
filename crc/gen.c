#include <stdio.h>
#include <stdlib.h>
#include <stdint.h>

uint8_t CRCPoly = 0x89;  // the value of our CRC-7 polynomial
uint8_t CRCTable[256];

uint8_t crc7_table[] = {
0x00,0x09,0x12,0x1B,0x24,0x2D,0x36,0x3F,0x48,0x41,0x5A,0x53,0x6C,0x65,0x7E,0x77,
0x19,0x10,0x0B,0x02,0x3D,0x34,0x2F,0x26,0x51,0x58,0x43,0x4A,0x75,0x7C,0x67,0x6E,
0x32,0x3B,0x20,0x29,0x16,0x1F,0x04,0x0D,0x7A,0x73,0x68,0x61,0x5E,0x57,0x4C,0x45,
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0x0E,0x07,0x1C,0x15,0x2A,0x23,0x38,0x31,0x46,0x4F,0x54,0x5D,0x62,0x6B,0x70,0x79
};

void GenerateCRCTable()
{
    int i, j;
 
    // generate a table value for all 256 possible byte values
    for (i = 0; i < 256; i++)
    {
        CRCTable[i] = (i & 0x80) ? i ^ CRCPoly : i;
        for (j = 1; j < 8; j++)
        {
            CRCTable[i] <<= 1;
            if (CRCTable[i] & 0x80)
                CRCTable[i] ^= CRCPoly;
        }
    }
}

uint8_t crc_add(uint8_t *table, uint8_t crc0, uint8_t nextbyte) {
  return table[(crc0<<1)^nextbyte];
}

uint8_t crc_byte(uint8_t *table, uint8_t *buf, size_t len) {
	uint8_t CRC=0;
	for (int i=0; i<len;i++) {
		CRC=crc_add(table,CRC,buf[i]);
	}
	return CRC;
}

uint8_t crc7(uint8_t *buf, size_t len) {
	return crc_byte(crc7_table,buf,len);
}


int main() {
	/*
	GenerateCRCTable();
	for (int i=0;i<sizeof(CRCTable);i++) {
		if (i%8==0) printf("\n");
		printf("0x%.2X,",CRCTable[i]);
	}
	printf("\n");
	*/
	// SD SPI commands
	// cmdX
	uint8_t cmdX[]={0x40|58,0x00,0x00,0x00,0x00};
	uint8_t cmdX_crc7=crc7(cmdX,sizeof(cmdX));
	printf("\ncmdX crc7:%.2X crc7<<1|1:%.2X\n\n",cmdX_crc7,cmdX_crc7<<1|1);
	return 0;
}

